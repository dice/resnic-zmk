## boards/arm/resnic/Kconfig.defconfig
```kconfig
if BOARD_RESNIC

config ZMK_KEYBOARD_NAME
    default "Resnic Keyboard"

if USB

config USB_NRFX
    default y

config USB_DEVICE_STACK
    default y

endif # USB

config BT_CTLR
    default BT

endif # BOARD_RESNIC
```
